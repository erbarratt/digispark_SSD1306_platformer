/*

  SSD1306_minimal.h - SSD1306 OLED Driver Library
  2015 Copyright (c) CoPiino Electronics All right reserved.
  
  Original Author: GOF Electronics Co. Ltd.
  Modified by: CoPiino Electronics
  
  CoPiino Electronics invests time and resources providing this open source code, 
	please support CoPiino Electronics and open-source hardware by purchasing 
	products from CoPiino Electronics!
  
  What is it?	
    This library is derived from GOFi2cOLED library, only for SSD1306 in I2C Mode.
    As the original library only supports Frame Buffered mode which requires to have
    at least 1024bytes of free RAM for a 128x64px display it is too big for smaller devices.
    
    So this a SSD1306 library that works great with ATTiny85 devices :)
    
  
  It is a free software; you can redistribute it and/or modify it 
  under the terms of BSD license, check license.txt for more information.
	All text above must be included in any redistribution.
*/

#include "SSD1306_minimal.h"

const unsigned char digital_font5x7[] PROGMEM =
 {
     0x00, 0x05, 0x07, 0x20,
     0x00, 0x00, 0x00, 0x00, 0x00, // char ' ' (0x20/32)
     0x00, 0x00, 0x2E, 0x00, 0x00, // char '!' (0x21/33)
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     0x36, 0x41, 0x36, 0x00, 0x00, // char '' (0x7F/127)
 };

 
void sendCommand(unsigned char command)
{
  begin();                       //initialize I2C
  beginTransmission(SlaveAddress); // begin I2C communication

  send(GOFi2cOLED_Command_Mode);	     // Set OLED Command mode
  send(command);

  endTransmission();    		     // End I2C communication
}

void sendData(unsigned char Data)
{
  begin();                    //initialize I2C
  beginTransmission(SlaveAddress); // begin I2C transmission
  send(GOFi2cOLED_Data_Mode);            // data mode
  send(Data);
  endTransmission();                    // stop I2C transmission
}

void init()
{
  
 //begin();
 
 //delay(5);	//wait for OLED hardware init
// constructor(128, 64);
 //SlaveAddress = address;

 sendCommand(GOFi2cOLED_Display_Off_Cmd);    /*display off*/

 sendCommand(Set_Multiplex_Ratio_Cmd);    /*multiplex ratio*/
 sendCommand(0x3F);    /*duty = 1/64*/

 sendCommand(Set_Display_Offset_Cmd);    /*set display offset*/
 sendCommand(0x00);


 sendCommand(0xB0); 			//set page address
 sendCommand(0x00); 	//set column lower address
 sendCommand(0x10); 	//set column higher address

    sendCommand(Set_Memory_Addressing_Mode_Cmd); 	//set addressing mode
    sendCommand(HORIZONTAL_MODE); 			//set horizontal addressing mode
    

 sendCommand(0x40);    /*set display starconstructort line*/

 sendCommand(Set_Contrast_Cmd);    /*contract control*/
 sendCommand(0xcf);    /*128*/

 sendCommand(Segment_Remap_Cmd);    /*set segment remap*/

 sendCommand(COM_Output_Remap_Scan_Cmd);    /*Com scan direction*/

 sendCommand(GOFi2cOLED_Normal_Display_Cmd);    /*normal / reverse*/

 sendCommand(Set_Display_Clock_Divide_Ratio_Cmd);    /*set osc division*/
 sendCommand(0x80);

 sendCommand(Set_Precharge_Period_Cmd);    /*set pre-charge period*/
 sendCommand(0xf1);

 sendCommand(Set_COM_Pins_Hardware_Config_Cmd);    /*set COM pins*/
 sendCommand(0x12);

 sendCommand(Set_VCOMH_Deselect_Level_Cmd);    /*set vcomh*/
 sendCommand(0x30);

 sendCommand(Deactivate_Scroll_Cmd);

 sendCommand(Charge_Pump_Setting_Cmd);    /*set charge pump enable*/
 sendCommand(Charge_Pump_Enable_Cmd);

 sendCommand(GOFi2cOLED_Display_On_Cmd);    /*display ON*/
}

void cursorTo( unsigned char row, unsigned char col ){

  sendCommand(0x00 | (0x0F & col) );  // low col = 0
  sendCommand(0x10 | (0x0F & (col>>4)) );  // hi col = 0
//  sendCommand(0x40 | (0x0F & row) ); // line #0

  sendCommand(0xb0 | (0x03 & row) );  // hi col = 0
  
  
}


void startScreen(){
  
  sendCommand(0x00 | 0x0);  // low col = 0
  sendCommand(0x10 | 0x0);  // hi col = 0
  sendCommand(0x40 | 0x0); // line #0

}

void clear() {
  sendCommand(0x00 | 0x0);  // low col = 0
  sendCommand(0x10 | 0x0);  // hi col = 0
  sendCommand(0x40 | 0x0); // line #0
    
    for (uint16_t i=0; i<=((128*64/8)/16); i++) 
    {
      // send a bunch of data in one xmission
      beginTransmission(SlaveAddress);
      send(GOFi2cOLED_Data_Mode);            // data mode
      for (uint8_t k=0;k<16;k++){
        send( 0 );
      }
      endTransmission();
    }
}


void displayX(int off) {
  sendCommand(0x00 | 0x0);  // low col = 0
  sendCommand(0x10 | 0x0);  // hi col = 0
  sendCommand(0x40 | 0x0); // line #0
    
    for (uint16_t i=0; i<=((128*64/8)/16); i++) 
    {
      // send a bunch of data in one xmission
      beginTransmission(SlaveAddress);
      send(GOFi2cOLED_Data_Mode);            // data mode
      for (uint8_t k=0;k<16;k++){
        send( i*16 + k + off);
      }
      endTransmission();
    }
}

unsigned char getFlash( const unsigned char * mem, unsigned int idx  ){
  return pgm_read_byte( &(mem[idx]) );
}

void printChar( unsigned char ch ){

    unsigned char data[5];

	//address = hex value of char * 5
	//get 5 bytes

    data[0]= getFlash(digital_font5x7, (ch*5)-156 );
    data[1]= getFlash(digital_font5x7, (ch*5) - 156 + 1);
    data[2]= getFlash(digital_font5x7, (ch*5) - 156 + 2);
    data[3]= getFlash(digital_font5x7, (ch*5) - 156 + 3);
    data[4]= getFlash(digital_font5x7, (ch*5) - 156 + 4);

    beginTransmission(SlaveAddress);
    send(GOFi2cOLED_Data_Mode);            // data mode

    send( 0x00 );
    send( data[0] );
    send( data[1] );
    send( data[2] );
    send( data[3] );
    send( data[4] );
    send( 0x00 );

    endTransmission();

}

void printString( char * pText ){
  unsigned char i;
  unsigned char len = strlen( pText );

  for (i=0;i<len;i++){
	  printChar(pText[i]);
  }

}


 
