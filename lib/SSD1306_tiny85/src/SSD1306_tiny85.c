#include "SSD1306_tiny85.h"

const unsigned char digital_font5x7[] PROGMEM =
{
	0x00, 0x05, 0x07, 0x20,
	0x00, 0x00, 0x00, 0x00, 0x00, // char ' ' (0x20/32)
	0x00, 0x00, 0x2E, 0x00, 0x00, // char '!' (0x21/33)
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	0x36, 0x41, 0x36, 0x00, 0x00, // char '' (0x7F/127)
};

	unsigned char USI_Buf[USI_BUF_SIZE]; // holds I2C send and receive data
	unsigned char USI_BufIdx = 1;     // current number of bytes in the send buff
	unsigned char CommandMode = 0;

	void OLED_addToUSIBuffer(unsigned char data) { // buffers up data to send


		if (USI_BufIdx >= USI_BUF_SIZE - 1){

			OLED_xmitBuffer(1);

			if(CommandMode){
				USI_Buf[USI_BufIdx] = SSD1306_Command_Mode;
			} else {
				USI_Buf[USI_BufIdx] = SSD1306_Data_Mode;
			}

			USI_BufIdx++;

		}

		USI_Buf[USI_BufIdx] = data;
		USI_BufIdx++; // inc for next byte in buffer

	}

	void OLED_xmitBuffer(unsigned char stop) { // actually sends the buffer

		//anything in buffer?
			if(USI_BufIdx == 1){
				return;
			}

		// try to Send a START condition on the TWI bus.
			USI_TWI_Master_Start();

		USI_TWI_Start_Transceiver_With_Data( USI_Buf, USI_BufIdx); 				// core func that does the work
		USI_BufIdx = 1;															//reset index back to 1, as 0 is always address set in init()

		if(stop){
			USI_TWI_Master_Stop();
		}

	}

	void OLED_init()
	{

		//write address as always the first byte in the buffer
		USI_Buf[0] = (SlaveAddress << TWI_ADR_BITS) | USI_SEND;

		USI_TWI_Master_Initialise();         									//initialize I2C

		unsigned char commands[] = {
			SSD1306_Display_Off_Cmd,										//display off
			Set_Multiplex_Ratio_Cmd,										//multiplex ratio
			0x3F,															//duty = 1/64
			Set_Display_Offset_Cmd,											//set display offset
			0x00,
			Set_Memory_Addressing_Mode_Cmd,									//set addressing mode
			HORIZONTAL_MODE,												//set horizontal addressing mode
			0xB0,															//set page address
			0x00,															//set column lower address
			0x10,															//set column higher address
			0x40,															//set display starconstructort line
			Set_Contrast_Cmd,												//contrast control
			0xcf,															//128
			Segment_Remap_Cmd,												//set segment remap
			COM_Output_Remap_Scan_Cmd,										//Com scan direction
			SSD1306_Normal_Display_Cmd,									//normal / reverse
			Set_Display_Clock_Divide_Ratio_Cmd,							//set osc division
			0x80,
			Set_Precharge_Period_Cmd,										//set pre-charge period
			0xf1,
			Set_COM_Pins_Hardware_Config_Cmd,								//set COM pins
			0x12,
			Set_VCOMH_Deselect_Level_Cmd,									//set vcomh
			0x30,
			Deactivate_Scroll_Cmd,											//Deactivate scrolling
			Charge_Pump_Setting_Cmd,										//set charge pump enable
			Charge_Pump_Enable_Cmd,
			SSD1306_Display_On_Cmd											//display ON
		};

		//CommandMode = 1;

		for(unsigned char i = 0; i < 28; i++){
			OLED_addToUSIBuffer(SSD1306_Command_Mode);
			OLED_addToUSIBuffer(commands[i]);

			if(i == 14){
				OLED_xmitBuffer(1);
			}
		}

		OLED_xmitBuffer(1);

	}

	void OLED_defineMemAddressArea(unsigned char x1, unsigned char y1, unsigned char x2, unsigned char y2){

		// command mode
		// 0x80 = 0b10000000
		// 	1	0	0	0	0	0	0	0
		//	Co	D/C
		//
		//	0b100001
		//	0	0	1	0	0	0	0	1
		//
		//

		OLED_addToUSIBuffer(SSD1306_Command_Mode);            	// command mode
		OLED_addToUSIBuffer(Set_Column_Address_Cmd);
		OLED_addToUSIBuffer(0);
		OLED_addToUSIBuffer(x1);
		OLED_addToUSIBuffer(x2);
		OLED_xmitBuffer(0);                    					// send current buffer but don't stop

		OLED_addToUSIBuffer(SSD1306_Command_Mode);            	// command mode
		OLED_addToUSIBuffer(Set_Page_Address_Cmd);
		OLED_addToUSIBuffer(0);
		OLED_addToUSIBuffer(y1);
		OLED_addToUSIBuffer(y2);
		OLED_xmitBuffer(1);                    					// stop I2C transmission

	}

	void OLED_clear() {

		//no idea what these do....
		//these are only for page address mode...
		//OLED_addCommand(0x00 | 0x0);   // low col = 0
		//OLED_addCommand(0x10 | 0x0);   // hi col = 0
		//OLED_addCommand(0x40 | 0x0);   // line #0

		//move cursor to 0,0??
		OLED_defineMemAddressArea(0, 0, 127, 7);

		//there's 8192 px
		//that's 1024 bytes
		//which is 32x32

		//seems like you don't need to reset cursor to clear -
		//i.e. writing overflows back to beginning, so as long as
		//1024 bytes written, screen will fill.

		//int x = 0;

		for (unsigned char i=0; i<= 32; i++){
		//for (unsigned char i=0; i<= (unsigned char)((128*64/8)/16); i++){
			OLED_addToUSIBuffer(SSD1306_Data_Mode);            			// data mode
			for (unsigned char k=0;k<=32;k++){
			//for (unsigned char k=0;k<16;k++){
				OLED_addToUSIBuffer(0x00);
				//x++;
			}
			OLED_xmitBuffer(1);
		}

		//char txt[5];
		//itoa(x, txt, 10);
		//
		//OLED_defineMemAddressArea(0, 0, 128, 8);
		//OLED_printString(txt);

	}

	void OLED_clearBlue(){
		OLED_defineMemAddressArea(0, 2, 127, 7);
		for (unsigned char i=0; i<= 24; i++){
			OLED_addToUSIBuffer(SSD1306_Data_Mode);            			// data mode
			for (unsigned char k=0;k<=32;k++){
				OLED_addToUSIBuffer(0x00);
			}
			OLED_xmitBuffer(1);
		}
	}

	void OLED_printChar( unsigned char ch ){

		//address = hex value of char * 5 - 156
		//get 5 bytes

		/*
		*
		*	Screen made up of 8X8 blocks, i.e. 8 vertical bytes
		*
		*	byte	1	2	3	4	5	6	7	8
		*
		*			0	0	0	0	0	0	0	0
		*			x	x	x	x	x	x	x	x
		*			0	0	0	0	0	0	0	0
		*			0	0	0	0	0	0	0	0
		*
		*	So a character in this case is made up of bytes 1 and 8 being blank
		*	and bytes 2 - 7 are the bytes that describe the px of that column of the char
		*
		*/
		OLED_addToUSIBuffer(SSD1306_Data_Mode);            				// data mode
		OLED_addToUSIBuffer(0x00);
		OLED_addToUSIBuffer(pgm_read_byte( &(digital_font5x7[(ch*5) - 156]) ));
		OLED_addToUSIBuffer(pgm_read_byte( &(digital_font5x7[(ch*5) - 156 + 1]) ));
		OLED_addToUSIBuffer(pgm_read_byte( &(digital_font5x7[(ch*5) - 156 + 2]) ));
		OLED_addToUSIBuffer(pgm_read_byte( &(digital_font5x7[(ch*5) - 156 + 3]) ));
		OLED_addToUSIBuffer(pgm_read_byte( &(digital_font5x7[(ch*5) - 156 + 4]) ));
		OLED_addToUSIBuffer(0x00);
		OLED_addToUSIBuffer(0x00);
		OLED_xmitBuffer(1);

	}

	void OLED_printString( char * pText ){

		for (unsigned char i=0; pText[i] != '\0'; i++){
			OLED_printChar(pText[i]);
		}

	}
